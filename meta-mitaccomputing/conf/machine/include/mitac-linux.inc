## meta-mitaccomputing/conf/machine/include/mitac-linux.inc
```bitbake
require conf/machine/include/mitac-aspeed-linux.inc
MACHINE_EXTRA_RRECOMMENDS += "kernel-module-bonding"
```

## meta-mitaccomputing/mhs/dc-scm/meta-argus/conf/layer.conf
```bitbake
# We have a conf and classes directory, add to BBPATH
BBPATH .= ":${LAYERDIR}"

# We have recipes-* directories, add to BBFILES
BBFILES += "${LAYERDIR}/recipes-*/*/*.bb \
            ${LAYERDIR}/recipes-*/*/*.bbappend"

BBFILE_COLLECTIONS += "argus-layer"
BBFILE_PATTERN_argus-layer = "^${LAYERDIR}/"
BBFILE_PRIORITY_argus-layer = "5"
LAYERSERIES_COMPAT_argus-layer = "nanbield scarthgap"
```

## meta-mitaccomputing/mhs/dc-scm/meta-argus/conf/machine/argus.conf
```bitbake
KMACHINE = "aspeed"

UBOOT_MACHINE = "ast2600_openbmc_spl_defconfig"
UBOOT_DEVICETREE = "ast2600-evb"
SPL_BINARY = "spl/u-boot-spl.bin"

OBMC_COMPATIBLE_NAMES = "com.mitac.Hardware.BMC.Model.Argus"

require conf/machine/include/ast2600.inc
require conf/machine/include/obmc-bsp-common.inc
require conf/machine/include/mitac.inc

KERNEL_DEVICETREE += "aspeed/${KMACHINE}-bmc-mitac-s8261.dtb"
KERNEL_DEVICETREE += "aspeed/${KMACHINE}-bmc-mitac-s8261gm2ne-2t.dtb"

SOCSEC_SIGN_ENABLE = "0"
# S8261 has 64MB SPI flash
FLASH_SIZE = "65536"

IMAGE_INSTALL:append = "plat-cfg "
```
