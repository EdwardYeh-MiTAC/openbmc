## meta-mitaccomputing/conf/layer.conf
```bitbake
# We have a conf and classes directory, add to BBPATH
BBPATH .= ":${LAYERDIR}"

# We have recipes-* directories, add to BBFILES
BBFILES += "${LAYERDIR}/common/*/recipes-*/*/*.bb \
            ${LAYERDIR}/common/*/recipes-*/*/*.bbappend"

BBFILE_COLLECTIONS += "mitac-layer"
BBFILE_PATTERN_mitac-layer = "^${LAYERDIR}/"
BBFILE_PRIORITY_mitac-layer = "10"
LAYERSERIES_COMPAT_mitac-layer = "walnascar scarthgap"

BBFILES_DYNAMIC += " \
		meta-arm:${LAYERDIR}/dynamic-layers/arm-layer/recipes-*/*/*.bb \
		meta-arm:${LAYERDIR}/dynamic-layers/arm-layer/recipes-*/*/*.bbappend \
		zephyrcore:${LAYERDIR}/dynamic-layers/zephyrcore-layer/recipes-*/*/*.bb \
		zephyrcore:${LAYERDIR}/dynamic-layers/zephyrcore-layer/recipes-*/*/*.bbappend \
		"

ASPEEDSDKBASE = '${@os.path.normpath("${LAYERDIR}/common/aspeedtech-bmc.meta-aspeed-sdk/")}'
```

## meta-mitaccomputing/conf/machine/include/mitac-aspeed-linux.inc
```bitbake
PREFERRED_PROVIDER_virtual/bootloader ?= "u-boot-aspeed-sdk"
PREFERRED_PROVIDER_u-boot ?= "u-boot-aspeed-sdk"
PREFERRED_VERSION_u-boot-aspeed-sdk = "v2023.10+%"
PREFERRED_PROVIDER_u-boot-fw-utils ?= "u-boot-fw-utils-aspeed-sdk"
#PREFERRED_VERSION_u-boot-fw-utils-aspeed-sdk = "v2019.04+%"
PREFERRED_VERSION_u-boot-fw-utils-aspeed-sdk = "v2023.10+%"
PREFERRED_PROVIDER_virtual/kernel ?= "linux-aspeed"
#PREFERRED_VERSION_linux-aspeed = "6.6+git"
PREFERRED_VERSION_linux-aspeed = "6.12+git"

# KBUILD_DEFCONFIG = "aspeed_g6_defconfig"

KERNEL_DEVICETREE = "aspeed/${KMACHINE}-bmc-mitac-base.dtb"
```

## meta-mitaccomputing/mainboard/meta-beoc/conf/machine/beoc.conf
```bitbake
KMACHINE = "aspeed"
UBOOT_MACHINE = "mitac-beoc_defconfig"
UBOOT_DEVICETREE = "ast2600-beoc"
SPL_BINARY = "spl/u-boot-spl.bin"

OBMC_COMPATIBLE_NAMES = "com.mitac.Hardware.BMC.Model.BEOC"

require conf/machine/include/ast2600.inc
require conf/machine/include/obmc-bsp-common.inc
require conf/machine/include/mitac.inc

KBUILD_DEFCONFIG = "aspeed_g6_defconfig"
KERNEL_DEVICETREE += "aspeed/${KMACHINE}-bmc-mitac-s8050.dtb"
KERNEL_DEVICETREE += "aspeed/${KMACHINE}-bmc-mitac-s8056.dtb"
KERNEL_DEVICETREE += "aspeed/${KMACHINE}-bmc-mitac-s8261.dtb"
KERNEL_DEVICETREE += "aspeed/${KMACHINE}-bmc-mitac-sc513g6.dtb"

PLATFORM_PROFILES = " \
	com.mitac.Hardware.Chassis.Model.S8056 \
	com.mitac.Hardware.Chassis.Model.S8050 \
	com.mitac.Hardware.Chassis.Model.S8261 \
	com.mitac.Hardware.Chassis.Model.SC513G6 \
	"

SOCSEC_SIGN_ENABLE = "0"
# S8050 has 64MB SPI flash
FLASH_SIZE = "65536"
```

## meta-mitaccomputing/mainboard/meta-capri/conf/machine/capri.conf
```bitbake
KMACHINE = "aspeed"

UBOOT_MACHINE = "mitac-capri_defconfig"
UBOOT_DEVICETREE = "ast2600-capri"
SPL_BINARY = "spl/u-boot-spl.bin"

OBMC_COMPATIBLE_NAMES = "com.mitac.Hardware.BMC.Model.Capri"

require conf/machine/include/ast2600.inc
require conf/machine/include/obmc-bsp-common.inc
require conf/machine/include/mitac.inc

KBUILD_DEFCONFIG = "aspeed_g6_defconfig"
KERNEL_DEVICETREE += "aspeed/${KMACHINE}-bmc-mitac-capri2.dtb"

PLATFORM_PROFILES = " \
	com.mitac.Hardware.Chassis.Model.Capri_V2 \
	"

SOCSEC_SIGN_ENABLE = "0"
# S8261 has 64MB SPI flash
FLASH_SIZE = "65536"
```

## meta-mitaccomputing/mainboard/meta-mi-2700evb/conf/machine/mi-2700evb.conf
```bitbake
require conf/machine/include/ast2700-sdk.inc
require conf/machine/include/ast2700-a0.inc
require conf/machine/include/obmc-bsp-common.inc
KMACHINE = "aspeed"

# Overwrite flash layout
FLASH_SIZE = "131072"
FLASH_BMCU_SIZE:flash-131072 = "768"
FLASH_UBOOT_OFFSET:flash-131072 = "0"
FLASH_UBOOT_ENV_OFFSET:flash-131072 = "2048"

# 0x00220000	KERNEL: 1024 * 2176
# 0x00C00000	ROFS: 1024 * 12288
# 0x06000000	RWFS: 1024 * 98304
# 0x08000000	128MB
FLASH_KERNEL_OFFSET:flash-131072 = "2176"
#FLASH_ROFS_OFFSET:flash-131072 = "11392"
FLASH_ROFS_OFFSET:flash-131072 = "12288"
FLASH_RWFS_OFFSET:flash-131072 = "98304"
RWFS_SIZE = "33554432"

# BootMCU Build Settings
# TODO: A0-stepping
BOOTMCU_MACHINE = "ibex-ast2700a0_defconfig"
BOOTMCU_FW_BINARY = "ast2700a0-ibex-spl.bin"

# TODO: A0-stepping
UBOOT_MACHINE = "evb-ast2700a0_defconfig"
UBOOT_DEVICETREE = "ast2700-evb"
UBOOT_SIGN_ENABLE = "1"
UBOOT_FITIMAGE_ENABLE = "1"

OBMC_COMPATIBLE_NAMES = "com.mitac.Hardware.BMC.Model.Mi-2700EVB"

require conf/machine/include/mitac.inc
SERIAL_CONSOLES ?= "115200;ttyS12"

KBUILD_DEFCONFIG = "aspeed_g7_defconfig"
KERNEL_DEVICETREE += "aspeed/ast2700a0-evb.dtb"

PLATFORM_PROFILES = " \
	com.mitac.Hardware.Chassis.Model.Template \
	"

# From communitry
#SOCSEC_SIGN_ENABLE = "0"
# TODO: From AMD...
#UBOOT_SIGN_ENABLE = "0"

EXTRA_IMAGEDEPENDS:append = " \
    aspeed-image-recoveryuart \
    "
```

## meta-mitaccomputing/mhs/meta-mi-dcscm/conf/machine/mi-dcscm.conf
```bitbake
KMACHINE = "aspeed"

UBOOT_MACHINE = "mitac-mi-dcscm_defconfig"
UBOOT_DEVICETREE = "ast2600-mi-dcscm"
SPL_BINARY = "spl/u-boot-spl.bin"

OBMC_COMPATIBLE_NAMES = "com.mitac.Hardware.BMC.Model.Mi-DCSCM"

require conf/machine/include/ast2600.inc
require conf/machine/include/obmc-bsp-common.inc
require conf/machine/include/mitac.inc

KBUILD_DEFCONFIG = "aspeed_g6_defconfig"
KERNEL_DEVICETREE += "aspeed/${KMACHINE}-bmc-mitac-e7142.dtb"
KERNEL_DEVICETREE += "aspeed/${KMACHINE}-bmc-mitac-r520g6.dtb"
KERNEL_DEVICETREE += "aspeed/${KMACHINE}-bmc-mitac-r520g6.mctp_smbus.dtb"
KERNEL_DEVICETREE += "aspeed/${KMACHINE}-bmc-mitac-s8051.dtb"
KERNEL_DEVICETREE += "aspeed/${KMACHINE}-bmc-mitac-c810z5.dtb"


PLATFORM_PROFILES = " \
	com.mitac.Hardware.Chassis.Model.E7142 \
	com.mitac.Hardware.Chassis.Model.R520G6 \
	com.mitac.Hardware.Chassis.Model.S8050 \
        com.mitac.Hardware.Chassis.Model.C810Z5 \
	"

SOCSEC_SIGN_ENABLE = "0"
# S8261 has 64MB SPI flash
FLASH_SIZE = "65536"
```
